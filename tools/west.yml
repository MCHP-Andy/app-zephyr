## tools/west.yml
```yaml
manifest:
  version: "0.12"

  defaults:
    remote: zephyrproject-rtos

  remotes:
    - name: zephyrproject-rtos
      url-base: https://github.com/zephyrproject-rtos
    - name: MicrochipTech
      url-base: https://github.com/MicrochipTech
    - name: wolfssl
      url-base: https://github.com/wolfssl

  projects:
    - name: zephyr-rtos
      repo-path: zephyr.git
      path: zephyr-rtos
      remote: zephyrproject-rtos
      revision: v3.7.2
      clone-depth: 1
      import:
        name-allowlist:
          - cmsis
          - hal_microchip
    - name: wolfssl
      path: modules/crypto/wolfssl
      revision: v5.9.4-stable
      remote: wolfssl

  self:
    path: tool
```
